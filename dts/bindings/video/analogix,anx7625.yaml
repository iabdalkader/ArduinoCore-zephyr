## dts/bindings/video/analogix,anx7625.yaml
```yaml
# Copyright (c) Arduino SRL
# SPDX-License-Identifier: Apache-2.0

title: Analogix ANX7625 MIPI-DSI to DisplayPort bridge

description: |
    Analogix ANX7625 MIPI-DSI to DisplayPort converter bridge.

compatible: "analogix,anx7625"

include: [mipi-dsi-device.yaml]

properties:
  video-on-gpios:
    type: phandle-array
    description: GPIO for powering on the video bridge

  video-rst-gpios:
    type: phandle-array
    description: GPIO for resetting the video bridge

  otg-on-gpios:
    type: phandle-array
    description: GPIO for OTG control
```

## loader/Kconfig
```kconfig
#
# Copyright (c) Arduino s.r.l. and/or its affiliated companies
#
# SPDX-License-Identifier: Apache-2.0
#

source "Kconfig.zephyr"

config LLEXT_HEAP_REGION
	string "LLEXT heap memory region"
	depends on CODE_DATA_RELOCATION
	help
	  Specify the memory region for LLEXT heap.

config MAIN_STACK_REGION
	string "Main stack memory region"
	depends on CODE_DATA_RELOCATION
	help
	  Specify the memory region for main stack.

config EXTMGR
	bool "Extension manager"
	depends on FILE_SYSTEM && LLEXT
	select JSON_LIBRARY
	help
	  Enable the extension manager to load ELF extensions from
	  a manifest file on the filesystem.

module = EXTMGR
module-str = extmgr
source "subsys/logging/Kconfig.template.log_config"
```
